## poky/meta-deneme/conf/layer.conf
```bitbake
# We have a conf and classes directory, add to BBPATH
BBPATH .= ":${LAYERDIR}"

# We have recipes-* directories, add to BBFILES
BBFILES += "${LAYERDIR}/recipes-*/*/*.bb \
            ${LAYERDIR}/recipes-*/*/*.bbappend"

BBFILE_COLLECTIONS += "meta-deneme"
BBFILE_PATTERN_meta-deneme = "^${LAYERDIR}/"
BBFILE_PRIORITY_meta-deneme = "7"

LAYERDEPENDS_meta-deneme = "core"
LAYERSERIES_COMPAT_meta-deneme = "kirkstone langdale"
```
